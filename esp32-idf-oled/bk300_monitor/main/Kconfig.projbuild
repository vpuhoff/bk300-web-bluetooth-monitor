## esp32-idf-oled/bk300_monitor/main/Kconfig.projbuild
```kconfig
menu "BK300 OLED options"

    config BK300_OLED_ENABLED
        bool "Enable SSD1306 OLED display"
        default y
        help
            Подключает встроенный мини-драйвер SSD1306 (через i2c_master) и
            выводит на экран статус BLE и текущее напряжение. Если экран не
            подключён физически — драйвер просто не сможет инициализироваться,
            и проект продолжит работать как обычный bk300_monitor (вывод в
            UART). Если выключить здесь — i2c вообще не дёргается.

    if BK300_OLED_ENABLED

        config BK300_OLED_I2C_PORT
            int "I2C port (0 or 1)"
            default 0
            range 0 1

        config BK300_OLED_I2C_SDA_GPIO
            int "I2C SDA GPIO"
            default 8
            help
                По умолчанию 8 — стандарт для ESP32-C3 dev-board. На классическом
                ESP32 (WROOM/WROVER) обычно 21. На ESP32-S3 dev-kit — тоже часто 8.

        config BK300_OLED_I2C_SCL_GPIO
            int "I2C SCL GPIO"
            default 9
            help
                По умолчанию 9 (ESP32-C3 dev-board). На классическом ESP32 — 22.

        config BK300_OLED_I2C_FREQ_HZ
            int "I2C clock (Hz)"
            default 100000
            range 100000 1000000
            help
                SSD1306 на длинных проводках / слабых подтяжках часто стабильно
                работает только на 100 kHz. Раньше здесь стоял дефолт 400 kHz —
                при этом i2c_master_probe() в ESP-IDF проверяет адрес **всегда на
                100 kHz**, из-за чего probe проходил, а передачи уже на 400 kHz
                ловили NACK и давали err=259 (ESP_ERR_INVALID_STATE).
                Если шина короткая и есть внешние 4.7k подтяжки — можно поднять
                до 400000.

        config BK300_OLED_I2C_ADDR
            hex "SSD1306 I2C address (7-bit)"
            default 0x3C
            help
                Большинство китайских модулей — 0x3C. Изредка попадаются с
                перепаянной перемычкой адреса — 0x3D.

        config BK300_OLED_TRY_ALT_ADDR
            bool "If init fails, retry alternate I2C address (0x3C <-> 0x3D)"
            default y
            help
                Часть модулей с ADDR-перемычкой отвечают на другой адрес. Включено
                по умолчанию: после неудачной инициализации пробуем второй адрес.

        config BK300_OLED_ROTATE_180
            bool "Rotate display 180 degrees"
            default y
            help
                Если экран физически смонтирован «вверх ногами», поверни.

    endif

endmenu

menu "BK300 WiFi / NTP sync"

    config BK300_WIFI_SSID
        string "WiFi SSID"
        default "DarkNet 2G"
        help
            Имя сети WiFi для синхронизации времени через NTP.
            WiFi включается только на время синхронизации (двойное нажатие BOOT),
            потом отключается и запускается BLE.

    config BK300_WIFI_PASS
        string "WiFi password"
        default ""
        help
            Пароль WiFi. Хранится в sdkconfig (не в исходном коде).
            Добавь sdkconfig и sdkconfig.defaults в .gitignore если это
            публичный репозиторий.

    config BK300_NTP_SERVER
        string "NTP server"
        default "pool.ntp.org"
        help
            NTP-сервер для синхронизации времени.

    config BK300_NTP_TIMEOUT_S
        int "NTP sync timeout (seconds)"
        default 15
        range 5 60
        help
            Максимальное время ожидания NTP-ответа. Если за это время
            время не синхронизировано — продолжаем без NTP.

    config BK300_BOOT_BUTTON_GPIO
        int "BOOT button GPIO"
        default 0
        help
            GPIO кнопки BOOT. На большинстве ESP32 dev-board это GPIO0.
            Двойное нажатие (два нажатия за 2 секунды) запускает NTP-синхронизацию.

    config BK300_BOOT_DOUBLE_PRESS_MS
        int "Double press window (ms)"
        default 2000
        range 500 5000
        help
            Временное окно для двойного нажатия BOOT в миллисекундах.

endmenu

menu "BK300 logging"

    config BK300_BT_VERBOSE_LOGS
        bool "Verbose BT_HCI / BT_GATT logs on UART (debug)"
        default n
        help
            Включает esp_log_level_set(BT_HCI/BT_GATT, DEBUG) — очень шумно.
            Для «боевого» монитора с OLED обычно достаточно WARNING/INFO.

endmenu
```

## esp32-idf-oled/bk300_monitor/sdkconfig.defaults
```kconfig
# Базовые умолчания для проекта bk300_monitor (ESP-IDF, любой чип с BLE).
# При первом `idf.py reconfigure` они кладутся в sdkconfig. Менять можно через `idf.py menuconfig`.

# Включаем BT/BLE и Bluedroid (тот же стек, что у Android в HCI-логе).
CONFIG_BT_ENABLED=y
CONFIG_BT_BLE_ENABLED=y
CONFIG_BT_BLUEDROID_ENABLED=y
CONFIG_BT_NIMBLE_ENABLED=n

# Нам нужен только GATT-Client; сервер выключаем чтобы экономить flash/heap.
CONFIG_BT_GATTC_ENABLE=y
CONFIG_BT_GATTS_ENABLE=n
CONFIG_BT_BLE_SMP_ENABLE=n

# В IDF 5.3+ legacy-API (esp_ble_gap_set_scan_params / start_scanning / esp_ble_gattc_open)
# спрятаны под флагом BT 4.2-features. Без него линкер ругается «undefined reference».
# Extended-сканирование 5.0 нам не нужно (Android в HCI тоже использовал legacy).
CONFIG_BT_BLE_42_FEATURES_SUPPORTED=y
CONFIG_BT_BLE_50_FEATURES_SUPPORTED=n
CONFIG_BT_BLE_FEAT_PERIODIC_ADV_ENH=n
CONFIG_BT_BLE_FEAT_PERIODIC_ADV_SYNC_TRANSFER=n

# Для классического ESP32 (Xtensa, dual-core) BTDM-контроллер должен быть в BLE-only режиме.
# На S3/C3/C6/H2 этой опции нет — Kconfig её просто игнорирует (BLE-only там умолчание).
CONFIG_BTDM_CTRL_MODE_BLE_ONLY=y
CONFIG_BTDM_CTRL_MODE_BR_EDR_ONLY=n
CONFIG_BTDM_CTRL_MODE_BTDM=n

# Логи. По умолчанию ESP_LOG отдаёт INFO — это нас устраивает.
# Но MAXIMUM_LEVEL=DEBUG нужен, чтобы DEBUG-вызовы НЕ вырезались компилятором
# (LOG_LOCAL_LEVEL ограничивается этим значением). Без него HCI/BTM трассы
# Bluedroid вообще не попадают в бинарь, даже если включены ниже.
CONFIG_LOG_DEFAULT_LEVEL_INFO=y
CONFIG_LOG_MAXIMUM_LEVEL_DEBUG=y

# HCI-trace в логе (DEBUG-уровень для bt_hci) — увидим LE Connection Update,
# Number Of Completed Packets, LE Meta события на низком уровне. Если что-то
# приходит на radio-уровне — увидим тут даже когда GATT не вызывает callback.
# В runtime включаем выборочно через esp_log_level_set("BT_HCI", ESP_LOG_DEBUG).
CONFIG_BT_LOG_HCI_TRACE_LEVEL_WARNING=y
CONFIG_BT_LOG_BTM_TRACE_LEVEL_WARNING=y
CONFIG_BT_LOG_GATT_TRACE_LEVEL_WARNING=y
CONFIG_BT_LOG_L2CAP_TRACE_LEVEL_WARNING=y
CONFIG_BK300_BT_VERBOSE_LOGS=n

# WiFi / NTP sync (двойное нажатие BOOT)
CONFIG_BK300_WIFI_SSID="DarkNet 2G"
CONFIG_BK300_WIFI_PASS="Integral320"
CONFIG_BK300_NTP_SERVER="pool.ntp.org"
CONFIG_BK300_NTP_TIMEOUT_S=15
CONFIG_BK300_BOOT_BUTTON_GPIO=0
CONFIG_BK300_BOOT_DOUBLE_PRESS_MS=2000
# Нужен WiFi стек
CONFIG_ESP_WIFI_ENABLED=y

# Главный таск настроен на достаточный стек — BLE-callbacks делают много работы.
CONFIG_ESP_MAIN_TASK_STACK_SIZE=8192

# OLED-вариант использует i2c_master + SSD1306 1024-байт framebuffer + render task.
# Ничего особенного в sdkconfig для этого не требуется (esp_driver_i2c подключается
# автоматически через REQUIRES в main/CMakeLists.txt).
# При желании настройки экрана меняй через `idf.py menuconfig` →
#   "BK300 OLED options" (default SDA=8 SCL=9 ADDR=0x3C для ESP32-C3 dev-board).

# Чтобы влез весь Bluedroid образ — берём огромный partition (без OTA).
CONFIG_PARTITION_TABLE_CUSTOM=n
CONFIG_PARTITION_TABLE_SINGLE_APP_LARGE=y
```
